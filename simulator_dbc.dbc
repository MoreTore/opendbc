VERSION ""

NS_ :

BS_:

BU_: XXX

BO_ 130 STEER: 8 XXX
 SG_ STEER_ANGLE : 23|16@0+ (0.05,-1600) [500|-500] "deg" XXX

BO_ 514 ENGINE_DATA: 8 XXX
 SG_ SPEED : 23|16@0+ (1,0) [0|32767] "kph" XXX

BO_ 540 CRZ_CTRL: 8 XXX
 SG_ CRZ_ACTIVE : 3|1@0+ (1,0) [0|1] "" XXX
 SG_ CRZ_AVAILABLE : 17|1@0+ (1,0) [0|255] "" XXX

BO_ 543 CRZ_EVENTS: 8 XXX
 SG_ CRZ_SPEED : 7|16@0+ (0.005,-0.5) [0|328] "kph" XXX

BO_ 357 PEDALS: 8 XXX
 SG_ STANDSTILL : 26|1@0+ (1,0) [0|16777215] "" XXX

BO_ 579 CAM_LKAS: 8 XXX
 SG_ LKAS_REQUEST : 3|12@0+ (1,-2048) [0|2048] "" XXX
